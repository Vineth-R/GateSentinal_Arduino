#include <WiFi.h>
#include <FirebaseESP32.h>
#include <Adafruit_Fingerprint.h>
#include <map>
#include <Wire.h>
#include <Adafruit_GFX.h>
#include <Adafruit_SH110X.h>
#include <time.h>

// Wi-Fi credentials
#define WIFI_SSID "Vineth"
#define WIFI_PASSWORD "Vanitha@2003"

// Firebase credentials
#define FIREBASE_HOST "gatesentinal-default-rtdb.firebaseio.com"
#define FIREBASE_AUTH "Nv4ZJVskYFkURBmCAmD8xMMTrxCKoJOWruAJY0Fs"

// Fingerprint sensor UART pins
#define RX_PIN 16
#define TX_PIN 17  
#define WAKEUP_PIN 18

// PIR sensor
#define PIR_PIN 27

// OLED display
#define SCREEN_WIDTH 128
#define SCREEN_HEIGHT 128
#define OLED_RESET    -1
#define I2C_ADDRESS   0x3C // Most SH1107 use 0x3C
Adafruit_SH1107 display(SCREEN_WIDTH, SCREEN_HEIGHT, &Wire, OLED_RESET);



// Firebase objects
FirebaseData firebaseData;
FirebaseConfig config;
FirebaseAuth auth;

// Fingerprint sensor
HardwareSerial mySerial(1);  // UART1 port for fingerprint sensor
Adafruit_Fingerprint finger(&mySerial);

// UID and mapping
String globalUid = "";
std::map<int, String> idMapping; // id -> name
int nextNumericID = 1;

// Command debounce
unsigned long lastCommandTimestamp = 0;

// 'logoLock (1)', 128x64px bitmap
// 'logoLock (1)', 128x64px
const unsigned char epd_bitmap_logoLock_1 [] PROGMEM = {
	0xff, 0xff, 0xff, 0xff, 0xff, 0xff, 0xff, 0xff, 0xff, 0xff, 0xff, 0xff, 0xff, 0xff, 0xff, 0xff, 
	0xff, 0xff, 0xff, 0xff, 0xff, 0xff, 0xff, 0xff, 0xff, 0xff, 0xff, 0xff, 0xff, 0xff, 0xff, 0xff, 
	0xff, 0xff, 0xff, 0xff, 0xff, 0xff, 0xff, 0xff, 0xff, 0xff, 0xff, 0xff, 0xff, 0xff, 0xff, 0xff, 
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	0xff, 0xff, 0xff, 0xff, 0xff, 0xff, 0xff, 0xff, 0xff, 0xff, 0xff, 0xff, 0xff, 0xff, 0xff, 0xff
};

//Correct fingerprint icon bitmap
const unsigned char epd_bitmap_logoLock_2 [] PROGMEM = {
	0xff, 0xff, 0xff, 0xff, 0xff, 0xff, 0xff, 0xff, 0xff, 0xff, 0xff, 0xff, 0xff, 0xff, 0xff, 0xff, 
	0xff, 0xff, 0xff, 0xff, 0xff, 0xff, 0xff, 0xff, 0xff, 0xff, 0xff, 0xff, 0xff, 0xff, 0xff, 0xff, 
	0xff, 0xff, 0xff, 0xff, 0xff, 0xff, 0xff, 0xff, 0xff, 0xff, 0xff, 0xff, 0xff, 0xff, 0xff, 0xff, 
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	0xff, 0xff, 0xff, 0xff, 0xff, 0xff, 0xff, 0xff, 0xff, 0xff, 0xff, 0xff, 0xff, 0xff, 0xff, 0xff
}; 

//incorrect fingerprint icon bitmap
const unsigned char epd_bitmap_logoLock_3 [] PROGMEM = {
	0xff, 0xff, 0xff, 0xff, 0xff, 0xff, 0xff, 0xff, 0xff, 0xff, 0xff, 0xff, 0xff, 0xff, 0xff, 0xff, 
	0xff, 0xff, 0xff, 0xff, 0xff, 0xff, 0xff, 0xff, 0xff, 0xff, 0xff, 0xff, 0xff, 0xff, 0xff, 0xff, 
	0xff, 0xff, 0xff, 0xff, 0xff, 0xff, 0xff, 0xff, 0xff, 0xff, 0xff, 0xff, 0xff, 0xff, 0xff, 0xff, 
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	0xff, 0xff, 0xff, 0xff, 0xff, 0xff, 0xff, 0xff, 0xff, 0xff, 0xff, 0xff, 0xff, 0xff, 0xff, 0xff
};
//Place finger icon for fp sensor
const unsigned char epd_bitmap_logoLock_4 [] PROGMEM = {
    0xff, 0xff, 0xff, 0xff, 0xff, 0xff, 0xff, 0xff, 0xff, 0xff, 0xff, 0xff, 0xff, 0xff, 0xff, 0xff, 
	0xff, 0xff, 0xff, 0xff, 0xff, 0xff, 0xff, 0xff, 0xff, 0xff, 0xff, 0xff, 0xff, 0xff, 0xff, 0xff, 
	0xff, 0xff, 0xff, 0xff, 0xff, 0xff, 0xff, 0xff, 0xff, 0xff, 0xff, 0xff, 0xff, 0xff, 0xff, 0xff, 
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	0xff, 0xff, 0xff, 0xff, 0xff, 0xff, 0xff, 0xff, 0xff, 0xff, 0xff, 0xff, 0xff, 0xff, 0xff, 0xff
};

//Enrollment successfull icon
const unsigned char epd_bitmap_logoLock_5 [] PROGMEM = {
	0xff, 0xff, 0xff, 0xff, 0xff, 0xff, 0xff, 0xff, 0xff, 0xff, 0xff, 0xff, 0xff, 0xff, 0xff, 0xff, 
	0xff, 0xff, 0xff, 0xff, 0xff, 0xff, 0xff, 0xff, 0xff, 0xff, 0xff, 0xff, 0xff, 0xff, 0xff, 0xff, 
	0xff, 0xff, 0xff, 0xff, 0xff, 0xff, 0xff, 0xff, 0xff, 0xff, 0xff, 0xff, 0xff, 0xff, 0xff, 0xff, 
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	0xff, 0xff, 0xff, 0xff, 0xff, 0xff, 0xff, 0xff, 0xff, 0xff, 0xff, 0xff, 0xff, 0xff, 0xff, 0xff
};


const unsigned char epd_bitmap_logoLock_6 [] PROGMEM = {
	0xff, 0xff, 0xff, 0xff, 0xff, 0xff, 0xff, 0xff, 0xff, 0xff, 0xff, 0xff, 0xff, 0xff, 0xff, 0xff, 
	0xff, 0xff, 0xff, 0xff, 0xff, 0xff, 0xff, 0xff, 0xff, 0xff, 0xff, 0xff, 0xff, 0xff, 0xff, 0xff, 
	0xff, 0xff, 0xff, 0xff, 0xff, 0xff, 0xff, 0xff, 0xff, 0xff, 0xff, 0xff, 0xff, 0xff, 0xff, 0xff, 
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	0xff, 0xff, 0xff, 0xff, 0xff, 0xff, 0xff, 0xff, 0xff, 0xff, 0xff, 0xff, 0xff, 0xff, 0xff, 0xff
};

const unsigned char epd_bitmap_logoLock_7 [] PROGMEM = {
	0xff, 0xff, 0xff, 0xff, 0xff, 0xff, 0xff, 0xff, 0xff, 0xff, 0xff, 0xff, 0xff, 0xff, 0xff, 0xff, 
	0xff, 0xff, 0xff, 0xff, 0xff, 0xff, 0xff, 0xff, 0xff, 0xff, 0xff, 0xff, 0xff, 0xff, 0xff, 0xff, 
	0xff, 0xff, 0xff, 0xff, 0xff, 0xff, 0xff, 0xff, 0xff, 0xff, 0xff, 0xff, 0xff, 0xff, 0xff, 0xff, 
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	0xff, 0xff, 0xff, 0xff, 0xff, 0xff, 0xff, 0xff, 0xff, 0xff, 0xff, 0xff, 0xff, 0xff, 0xff, 0xff
};


void iconDisplayHome(){
    display.clearDisplay();
    // Updated for 128x128 display - centered bitmap
    display.drawBitmap(0,0, epd_bitmap_logoLock_1, 128, 128, SH110X_WHITE);
    display.display();
}

void iconDisplayFPRecognized(){
    display.clearDisplay();
    // Updated for 128x128 display - centered bitmap
    display.drawBitmap(0,0, epd_bitmap_logoLock_2, 128, 128, SH110X_WHITE);
    display.display();
}

void iconDisplayFPIncorrect(){
    display.clearDisplay();
    // Updated for 128x128 display - centered bitmap
    display.drawBitmap(0,0, epd_bitmap_logoLock_3, 128, 128, SH110X_WHITE);
    display.display();
}

void iconDisplayPlaceFinger(){
    display.clearDisplay();
    // Updated for 128x128 display - centered bitmap
    display.drawBitmap(0,0, epd_bitmap_logoLock_4, 128, 128, SH110X_WHITE);
    display.display();
}

void iconDisplayEnrollSuccess(){
    display.clearDisplay();
    // Updated for 128x128 display - centered bitmap
    display.drawBitmap(0,0, epd_bitmap_logoLock_5, 128, 128, SH110X_WHITE);
    display.display();
}

void iconDisplayEnrollFailure(){
    display.clearDisplay();
    // Updated for 128x128 display - centered bitmap
    display.drawBitmap(0,0, epd_bitmap_logoLock_6, 128, 128, SH110X_WHITE);
    display.display();
}

void iconDisplayDeleteFingerprint(){
    display.clearDisplay();
    // Updated for 128x128 display - centered bitmap
    display.drawBitmap(0,0, epd_bitmap_logoLock_7, 128, 128, SH110X_WHITE);
    display.display();
}
// ----------- FUNCTION DECLARATIONS ------------
void connectWiFi();
String getUidFromDatabase();
void loadMappingFromFirebase();
void textDisplay(const String &text,int x, int y);
void checkFirebaseCommands();
void enrollFingerprint(int id, String username);
void deleteFingerprint(int id);
void recognizeFingerprint();
void pirSense();
void sendGateUnlockCommand();

// ----------- SETUP ------------
void setup() {
  Serial.begin(115200);
  mySerial.begin(57600, SERIAL_8N1, RX_PIN, TX_PIN);
  finger.begin(57600);
  pinMode(WAKEUP_PIN, INPUT_PULLUP);
  pinMode(PIR_PIN, INPUT);

   // Initialize OLED display
  if (!display.begin(I2C_ADDRESS, true)) {
    Serial.println("SH1107 OLED not found!");
    while (1) {
      delay(1000); // Prevent watchdog reset
    }
  }
  display.clearDisplay();
  display.setTextSize(1);
  display.setTextColor(SH110X_WHITE);

  // Display initial logo
  iconDisplayHome();
  delay(1000);

  // Connect to WiFi
  connectWiFi();

  // Initialize Firebase and reconnect WiFi automatically
  config.host = FIREBASE_HOST;
  config.signer.tokens.legacy_token = FIREBASE_AUTH;
  Firebase.begin(&config, &auth);
  Firebase.reconnectWiFi(true);

  // Get UID from Firebase path /User/id
  globalUid = getUidFromDatabase();
  if (globalUid.length() == 0) {
    textDisplay("UID not",10,10);
		delay(750);
		textDisplay("found!",10,50);
		delay(750);
    Serial.println("No UID found!");
    while (1);
  }
  display.clearDisplay();

  // Load fingerprint-to-user mapping from Firebase
  loadMappingFromFirebase();

  // Verify fingerprint sensor connection
  if (!finger.verifyPassword()) {
    textDisplay("Fingerprint",10,10);
		delay(750);
		textDisplay("sensor",10,50);
		delay(750);
		textDisplay("error!",10,80);
		delay(750);
    Serial.println("Fingerprint sensor error!");
    while (1);
  }

  // Set fingerprint sensor LED to idle (purple)
  finger.LEDcontrol(FINGERPRINT_LED_ON, 0, FINGERPRINT_LED_PURPLE, 0);

  // Configure NTP time synchronization
  configTime(0, 0, "pool.ntp.org", "time.nist.gov");
  
  // Wait for time to be set
  Serial.print("Waiting for NTP time sync: ");
  time_t nowSecs = time(nullptr);
  while (nowSecs < 8 * 3600 * 2) {
    delay(500);
    Serial.print(".");
    nowSecs = time(nullptr);
  }
  Serial.println(" Time synchronized!");

  textDisplay("System",10,10);
	delay(750);
	textDisplay("Ready!",10,50);
	delay(750);
  Serial.println("System Ready.");
  delay(1500);


}

// ----------- LOOP ------------
void loop() {
	iconDisplayHome();
  // 1. Continuously monitor the PIR sensor
  pirSense();

  // 2. Check for enroll or delete commands from Firebase
  checkFirebaseCommands();

  // 3. If a finger is detected, perform fingerprint recognition
  if (digitalRead(WAKEUP_PIN) == LOW) {
    finger.LEDcontrol(FINGERPRINT_LED_ON, 0, FINGERPRINT_LED_BLUE, 0);
    recognizeFingerprint();
    finger.LEDcontrol(FINGERPRINT_LED_ON, 0, FINGERPRINT_LED_PURPLE, 0);
  } else {
    finger.LEDcontrol(FINGERPRINT_LED_ON, 0, FINGERPRINT_LED_PURPLE, 0);
    delay(1000); // Wait a second before next check
  }

  delay(50); // Short delay for responsiveness
}

// ----------- PIR CONTINUOUS MONITORING ------------
void pirSense() {
  static unsigned long startTime = 0;     // Start time of the 1-minute window
  static int motionCount = 0;             // Count of motion activations
  static bool alertTriggered = false;     // Flag to indicate if an alert was triggered
  static unsigned long lastNoMotionTime = 0;  // Timer for displaying "No motion" logs

  bool motionDetected = digitalRead(PIR_PIN) == HIGH;  // Check PIR sensor state

  if (motionDetected) {
    static unsigned long lastMotionTime = 0;  // Last motion detection time
    // Debounce: ensure at least 11 seconds between triggers
    if (millis() - lastMotionTime > 11000) {
      motionCount++;  // Increase motion count
      lastMotionTime = millis();
      Serial.println("Motion detected!");
    }
  } else {
    // Log "No motion detected" every 500ms
    if (millis() - lastNoMotionTime > 500) {
      Serial.println("No motion detected");
      lastNoMotionTime = millis();
    }
  }

  if (startTime == 0) {
    startTime = millis();  // Initialize the 1-minute timer
  }

  // Check if 1 minute has elapsed
  if (millis() - startTime >= 60000) {
    if (motionCount >= 4 && motionCount <= 6) {
      Serial.println("Alert: Motion detected 4 to 6 times in 1 minute!");
			sendAlert();
      alertTriggered = true;
    }
    // Reset timer and counter for the next window
    startTime = 0;
    motionCount = 0;
    alertTriggered = false;
  }
}

// ----------- FIREBASE FINGERPRINT COMMANDS ------------
void checkFirebaseCommands() {
  String commandPath = "/fingerprintCommands/" + globalUid;
  if (Firebase.getInt(firebaseData, commandPath + "/timestamp")) {
    unsigned long commandTimestamp = firebaseData.intData();
    if (commandTimestamp > lastCommandTimestamp) {
      lastCommandTimestamp = commandTimestamp;
      if (Firebase.getString(firebaseData, commandPath + "/action")) {
        String action = firebaseData.stringData();
        int fingerprintId = 0;
        String username = "";
        if (Firebase.getInt(firebaseData, commandPath + "/fingerprintId")) {
          fingerprintId = firebaseData.intData();
        }
        if (Firebase.getString(firebaseData, commandPath + "/username")) {
          username = firebaseData.stringData();
        }
        Serial.print("Firebase command received: ");
        Serial.print("Action: ");
        Serial.print(action);
        Serial.print(", ID: ");
        Serial.print(fingerprintId);
        Serial.print(", Username: ");
        Serial.println(username);

        if (action == "enroll") {
          enrollFingerprint(fingerprintId, username);
          finger.LEDcontrol(FINGERPRINT_LED_ON, 0, FINGERPRINT_LED_PURPLE, 0);
        } else if (action == "delete") {
          deleteFingerprint(fingerprintId);
          finger.LEDcontrol(FINGERPRINT_LED_ON, 0, FINGERPRINT_LED_PURPLE, 0);
        }
        Firebase.setString(firebaseData, commandPath + "/status", "processed");
      }
    }
  }
}

// ----------- ENROLL FINGERPRINT ------------
void enrollFingerprint(int id, String username) {
  int retryCount = 0;
  const int maxRetries = 3; // Maximum number of retries

  while (retryCount < maxRetries) {
    Serial.println("Start enrollment process:");
    for (int i = 0; i < 8; ++i) {
      finger.LEDcontrol(FINGERPRINT_LED_ON, 0, FINGERPRINT_LED_BLUE, 0);
      textDisplay("Place",10,10);
			delay(750);
			textDisplay("finger (1/2)",10,50);
			delay(750);
      if (i == 0)
        Serial.println("Please keep your finger on the fingerprint sensor (1/2)...");
      delay(250);
      finger.LEDcontrol(FINGERPRINT_LED_ON, 0, FINGERPRINT_LED_PURPLE, 0);
      delay(250);
    }

    int result;
    while (true) {
      finger.LEDcontrol(FINGERPRINT_LED_ON, 0, FINGERPRINT_LED_BLUE, 0);
      textDisplay("Place",10,10);
			delay(750);
			textDisplay("finger (1/2)",10,40);
			delay(750);
      result = finger.getImage();
      if (result == FINGERPRINT_OK) {
        Serial.println("First fingerprint image captured.");
        break;
      }
      delay(100);
    }

    finger.LEDcontrol(FINGERPRINT_LED_ON, 0, FINGERPRINT_LED_BLUE, 0);
    textDisplay("Processing (1/2)",10,30);
    Serial.println("Processing first fingerprint image...");
    result = finger.image2Tz(1);
    if (result != FINGERPRINT_OK) {
      finger.LEDcontrol(FINGERPRINT_LED_ON, 0, FINGERPRINT_LED_RED, 0);
      textDisplay("Error 1/2",10,10);
			delay(750);
			textDisplay("Retry",10,40);
			delay(750);
      Serial.println("Error processing first fingerprint image. Please try again.");
      delay(1500);
      finger.LEDcontrol(FINGERPRINT_LED_ON, 0, FINGERPRINT_LED_PURPLE, 0);
      retryCount++;
      continue; // Retry the process
    }

    finger.LEDcontrol(FINGERPRINT_LED_ON, 0, FINGERPRINT_LED_PURPLE, 0);
    textDisplay("Remove",10,10);
		delay(750);
		textDisplay("Finger",10,40);
		delay(750);
    Serial.println("Please remove your finger.");
    delay(1500);

    for (int i = 0; i < 8; ++i) {
      finger.LEDcontrol(FINGERPRINT_LED_ON, 0, FINGERPRINT_LED_BLUE, 0);
      textDisplay("Place",10,10);
			delay(750);
			textDisplay("Same",10,40);
			delay(750);
			textDisplay("Finger (2/2)",10,60);
			delay(750);
      if (i == 0)
        Serial.println("Now place the same finger again (2/2)...");
      delay(250);
      finger.LEDcontrol(FINGERPRINT_LED_ON, 0, FINGERPRINT_LED_PURPLE, 0);
      delay(250);
    }

    while (true) {
      finger.LEDcontrol(FINGERPRINT_LED_ON, 0, FINGERPRINT_LED_BLUE, 0);
      textDisplay("Place",10,10);
			delay(750);
			textDisplay("Same",10,40);
			delay(750);
			textDisplay("Finger (2/2)",10,60);
			delay(750);
      result = finger.getImage();
      if (result == FINGERPRINT_OK) {
        Serial.println("Second fingerprint image captured.");
        break;
      }
      delay(100);
    }

    finger.LEDcontrol(FINGERPRINT_LED_ON, 0, FINGERPRINT_LED_BLUE, 0);
    textDisplay("Processing",10,10);
		delay(750);
		textDisplay("(2/2)",10,40);
		delay(750);
    Serial.println("Processing second fingerprint image...");
    result = finger.image2Tz(2);
    if (result != FINGERPRINT_OK) {
      finger.LEDcontrol(FINGERPRINT_LED_ON, 0, FINGERPRINT_LED_RED, 0);
      textDisplay("Error",10,10);
			delay(750);
			textDisplay("2/2",10,40);
			delay(750);
			textDisplay("Retry",10,60);
			delay(750);
      Serial.println("Error processing second fingerprint image. Please try again.");
      delay(1500);
      finger.LEDcontrol(FINGERPRINT_LED_ON, 0, FINGERPRINT_LED_PURPLE, 0);
      retryCount++;
      continue; // Retry the process
    }

    Serial.println("Creating fingerprint model...");
    result = finger.createModel();
    if (result != FINGERPRINT_OK) {
      finger.LEDcontrol(FINGERPRINT_LED_ON, 0, FINGERPRINT_LED_RED, 0);
      textDisplay("Model",10,10);
			delay(750);
			textDisplay("create",10,40);
			delay(750);
			textDisplay("error",10,60);
			delay(750);
      Serial.println("Error creating fingerprint model.");
      delay(1500);
      finger.LEDcontrol(FINGERPRINT_LED_ON, 0, FINGERPRINT_LED_PURPLE, 0);
      retryCount++;
      continue; // Retry the process
    }

    Serial.print("Storing fingerprint model at ID: ");
    Serial.println(id);
    result = finger.storeModel(id);
    if (result == FINGERPRINT_OK) {
			iconDisplayEnrollSuccess();
			delay(2000);
      finger.LEDcontrol(FINGERPRINT_LED_ON, 0, FINGERPRINT_LED_BLUE, 0);
      textDisplay("Enroll",10,10);
			delay(750);
			textDisplay("Done",10,40);
			delay(750);
			textDisplay("nID: ",10,60);
			delay(750);
			textDisplay(String(id),10,80);
			delay(750);
      Serial.print("Fingerprint enrollment successful! ID: ");
      Serial.print(id);
      Serial.print(", Name: ");
      Serial.println(username);

      // Save username mapping locally and update Firebase
      idMapping[id] = username;
      String path = "/users/" + globalUid + "/Fingerprints/" + String(id);
      Firebase.setString(firebaseData, path, username);
      delay(2000);
      finger.LEDcontrol(FINGERPRINT_LED_ON, 0, FINGERPRINT_LED_PURPLE, 0);
      return; // Enrollment successful; exit function
    } else {
			iconDisplayEnrollFailure();
			delay(2000);
      finger.LEDcontrol(FINGERPRINT_LED_ON, 0, FINGERPRINT_LED_RED, 0);
      textDisplay("Enroll",10,10);
			delay(750);
			textDisplay("/store",10,40);
			delay(750);
			textDisplay("error",10,60);
			delay(750);
      Serial.println("Enroll/store error!");
      delay(2000);
      finger.LEDcontrol(FINGERPRINT_LED_ON, 0, FINGERPRINT_LED_PURPLE, 0);
      retryCount++;
      continue; // Retry the process
    }
  }

  // After maximum retries, enrollment failed
  Serial.println("Enrollment failed after maximum retries.");
  textDisplay("Enroll failed.",10,10);
	delay(750);
	textDisplay("Try again.",10,40);
	delay(750);
  delay(2000);
  finger.LEDcontrol(FINGERPRINT_LED_ON, 0, FINGERPRINT_LED_PURPLE, 0);
}

// ----------- DELETE FINGERPRINT ------------
void deleteFingerprint(int id) {
  finger.LEDcontrol(FINGERPRINT_LED_ON, 0, FINGERPRINT_LED_BLUE, 0);
  textDisplay("Deleting..",10,10);
	delay(750);
	textDisplay("ID: " + String(id),10,40);
	delay(750);
  Serial.print("Deleting fingerprint with ID: ");
  Serial.println(id);
  int result = finger.deleteModel(id);
  if (result == FINGERPRINT_OK) {
		iconDisplayDeleteFingerprint();
		delay(2000);
    finger.LEDcontrol(FINGERPRINT_LED_ON, 0, FINGERPRINT_LED_BLUE, 0);
    textDisplay("Deleting..",10,10);
		delay(750);
		textDisplay("ID: " + String(id),10,40);
		delay(750);
    Serial.print("Fingerprint successfully deleted! ID: ");
    Serial.println(id);
    idMapping.erase(id);
    String path = "/users/" + globalUid + "/Fingerprints/" + String(id);
    Firebase.deleteNode(firebaseData, path);
    delay(2000);
  } else {
    finger.LEDcontrol(FINGERPRINT_LED_ON, 0, FINGERPRINT_LED_RED, 0);
    textDisplay("Delete",10,10);
		delay(750);
		textDisplay("failed",10,40);
		delay(750);
    Serial.println("Couldn't delete fingerprint. Unknown error.");
    delay(2000);
  }
  finger.LEDcontrol(FINGERPRINT_LED_ON, 0, FINGERPRINT_LED_PURPLE, 0);
}

// ----------- RECOGNIZE FINGERPRINT ------------
void recognizeFingerprint() {
  Serial.println("Ready to recognize fingerprint. Please place your finger on the sensor...");
  for (int i = 0; i < 8; ++i) {
    finger.LEDcontrol(FINGERPRINT_LED_ON, 0, FINGERPRINT_LED_BLUE, 0);
    textDisplay("Place",10,10);
		delay(750);
		textDisplay("finger",10,40);
		delay(750);
		textDisplay("to check",10,60);
    delay(250);
    finger.LEDcontrol(FINGERPRINT_LED_ON, 0, FINGERPRINT_LED_PURPLE, 0);
    delay(250);
  }

//Get fingerprint image
  int result;
  while (true) {
    finger.LEDcontrol(FINGERPRINT_LED_ON, 0, FINGERPRINT_LED_BLUE, 0);
    int numberOT = 5;
    do{      
      textDisplay("Place",10,10);
			delay(750);
			textDisplay("finger",10,40);
			delay(750);
			textDisplay("to check",10,70);
			delay(750);
      numberOT-- ;
      delay(3000);
      iconDisplayPlaceFinger();
      delay(1500);
    }while(numberOT < 2);

    result = finger.getImage();
    if (result == FINGERPRINT_OK) {
      Serial.println("Fingerprint image captured for recognition.");
      break;
    }
    if (result != FINGERPRINT_NOFINGER) {
      finger.LEDcontrol(FINGERPRINT_LED_ON, 0, FINGERPRINT_LED_RED, 0);
      textDisplay("Sensor error",10,10);
			delay(750);
      Serial.println("Error capturing fingerprint image!");
      delay(1500);
      finger.LEDcontrol(FINGERPRINT_LED_ON, 0, FINGERPRINT_LED_PURPLE, 0);
      return;
    }
    delay(50);
  }

  finger.LEDcontrol(FINGERPRINT_LED_ON, 0, FINGERPRINT_LED_BLUE, 0);
  textDisplay("Processing..",10,10);
  Serial.println("Processing fingerprint image...");
  result = finger.image2Tz();
  if (result != FINGERPRINT_OK) {
    finger.LEDcontrol(FINGERPRINT_LED_ON, 0, FINGERPRINT_LED_RED, 0);
    textDisplay("Process error",10,10);
		delay(750);
    Serial.println("Fingerprint processing/convert error!");
    delay(1500);
    finger.LEDcontrol(FINGERPRINT_LED_ON, 0, FINGERPRINT_LED_PURPLE, 0);
    return;
  }

  Serial.println("Searching for fingerprint in database...");
  result = finger.fingerSearch();
  if (result == FINGERPRINT_OK) {
     // Match found!
    iconDisplayFPRecognized();
    delay(2000);

    int matchedID = finger.fingerID;
    String name = idMapping.count(matchedID) ? idMapping[matchedID] : "Enrolled";
    finger.LEDcontrol(FINGERPRINT_LED_ON, 0, FINGERPRINT_LED_BLUE, 0);
    textDisplay("ID: " + String(matchedID),10,10);
		delay(750);
		textDisplay("\nName: " + name,10,40);
		delay(750);
    Serial.print("Fingerprint recognized! ID: ");
		Serial.print(matchedID);
    Serial.print(", Name: ");
    Serial.println(name);
    delay(2000);
    
    // Send gate control command on fingerprint recognition
    sendGateUnlockCommand();
    
  }else {
    // No match found
    iconDisplayFPIncorrect();
    delay(2000);
    finger.LEDcontrol(FINGERPRINT_LED_ON, 0, FINGERPRINT_LED_RED, 0);
    textDisplay("Not found",10,10);
    Serial.println("Fingerprint not found in the database.");
    delay(2000);
  }
  finger.LEDcontrol(FINGERPRINT_LED_ON, 0, FINGERPRINT_LED_PURPLE, 0);
}

void sendGateUnlockCommand() {
  String gateControlPath = "/gateControl";
  
  // Get current Unix timestamp in milliseconds (same format as Dart)
  time_t now = time(nullptr);
  unsigned long long timestamp = (unsigned long long)now * 1000ULL;
  
  // Set gate command "unlock" with "pending" status and current timestamp
  if (Firebase.setString(firebaseData, gateControlPath + "/command", "unlock"))
    Serial.println("✅ Unlock command sent!");
  else
    Serial.println("❌ Failed to send unlock command: " + firebaseData.errorReason());
    
  if (Firebase.setString(firebaseData, gateControlPath + "/status", "pending"))
    Serial.println("✅ Gate status set to pending");
  else
    Serial.println("❌ Failed to set gate status: " + firebaseData.errorReason());
  
  if (Firebase.setInt(firebaseData, gateControlPath + "/lastUpdated", timestamp))
    Serial.println("✅ Gate lastUpdated timestamp set");
  else
    Serial.println("❌ Failed to set gate timestamp: " + firebaseData.errorReason());
}

// ----------- UTILITY FUNCTIONS ------------
void textDisplay(const String &text, int x, int y) {
  display.clearDisplay();
  display.setCursor(x,y);
  display.setTextSize(2);
  display.setTextColor(SH110X_WHITE);
  display.println(text);
  display.display();
}

void connectWiFi() {
  textDisplay("Connecting...",10,10);
  Serial.println("Connecting WiFi...");
  WiFi.begin(WIFI_SSID, WIFI_PASSWORD);
  while (WiFi.status() != WL_CONNECTED) {
    delay(500);
    Serial.print(".");
  }
  textDisplay("WiFi",10,10);
	delay(750);
	textDisplay("Connected!",10,40);
	delay(750);
  Serial.println("WiFi Connected!");
  delay(500);
}

// ----------- GET UID FROM FIREBASE ------------
String getUidFromDatabase() {
  if (Firebase.getString(firebaseData, "/User/id")) {
    String uid = firebaseData.stringData();
    Serial.print("UID: ");
    Serial.println(uid);
    return uid;
  }
  Serial.println("No UID: " + firebaseData.errorReason());
  return "";
}

// ----------- LOAD MAPPING FROM FIREBASE ------------
void loadMappingFromFirebase() {
  idMapping.clear();
  String path = "/users/" + globalUid + "/Fingerprints";
  if (Firebase.getJSON(firebaseData, path)) {
    FirebaseJson &json = firebaseData.jsonObject();
    size_t len = json.iteratorBegin();
    int type;
    String key, value;
    for (size_t i = 0; i < len; i++) {
      json.iteratorGet(i, type, key, value);
      if (type == FirebaseJson::JSON_OBJECT || type == FirebaseJson::JSON_STRING || type == FirebaseJson::JSON_INT) {
        int id = key.toInt();
        idMapping[id] = value;
        if (id >= nextNumericID)
          nextNumericID = id + 1;
      }
    }
    json.iteratorEnd();
    Serial.println("Loaded fingerprint map from Firebase.");
  } else {
    Serial.println("Mapping load fail: " + firebaseData.errorReason());
}
}

// ----------- SEND ALERT TO FIREBASE ------------
void sendAlert() {
  String alertsPath = "/alerts";
  String alertId = "7SmpYGZkm5VC5PGTVQlhVxA2ugy1";
  unsigned long timestamp = millis();
  
  String fullAlertPath = alertsPath + "/" + alertId;
  
  // Set alert type (fixed)
  if (Firebase.setString(firebaseData, fullAlertPath + "/type", "motion_alert"))
    Serial.println("✅ Alert type set: motion_alert");
  else
    Serial.println("❌ Failed to set alert type: " + firebaseData.errorReason());
  
  // Set alert description (fixed)
  if (Firebase.setString(firebaseData, fullAlertPath + "/description", "Motion detected at the gate."))
    Serial.println("✅ Alert description set: Motion detected at the gate.");
  else
    Serial.println("❌ Failed to set alert description: " + firebaseData.errorReason());
  
  // Set timestamp
  if (Firebase.setInt(firebaseData, fullAlertPath + "/timestamp", timestamp))
    Serial.println("✅ Alert timestamp set: " + String(timestamp));
  else
    Serial.println("❌ Failed to set alert timestamp: " + firebaseData.errorReason());
}